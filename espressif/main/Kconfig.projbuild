## espressif/main/Kconfig.projbuild
```kconfig
menu "Gasmeter Configuration"

    config BLINK_GPIO
        int "Blink GPIO number"
        range 0 48
        default 8 if IDF_TARGET_ESP32C3 || IDF_TARGET_ESP32H2
        default 18 if IDF_TARGET_ESP32S2
        default 48 if IDF_TARGET_ESP32S3
        default 33
        help
            GPIO number (IOxx) to blink on and off.
            Some GPIOs are used for other purposes (flash connections, etc.) and cannot be used to blink.

    config BLINK_PERIOD
        int "Blink period in ms"
        range 10 3600000
        default 1000
        help
            Define the blinking period in milliseconds.

    config ESP_WIFI_SSID
        string "WiFi SSID"
        default "myssid"
        help
            SSID (network name) for the example to connect to.

    config ESP_WIFI_PASSWORD
        string "WiFi Password"
        default "mypassword"
        help
            WiFi password (WPA or WPA2) for the example to use.

    config ESP_MAXIMUM_RETRY
        int "Maximum retry"
        default 5
        help
            Set the Maximum retry to avoid station reconnecting to the AP unlimited when the AP is really inexistent.

    choice ESP_WIFI_SCAN_AUTH_MODE_THRESHOLD
        prompt "WiFi Scan auth mode threshold"
        default ESP_WIFI_AUTH_OPEN
        help
            The weakest authmode to accept in the scan mode.

        config ESP_WIFI_AUTH_OPEN
            bool "OPEN"
        config ESP_WIFI_AUTH_WEP
            bool "WEP"
        config ESP_WIFI_AUTH_WPA_PSK
            bool "WPA PSK"
        config ESP_WIFI_AUTH_WPA2_PSK
            bool "WPA2 PSK"
        config ESP_WIFI_AUTH_WPA_WPA2_PSK
            bool "WPA/WPA2 PSK"
        config ESP_WIFI_AUTH_WPA3_PSK
            bool "WPA3 PSK"
        config ESP_WIFI_AUTH_WPA2_WPA3_PSK
            bool "WPA2/WPA3 PSK"
        config ESP_WIFI_AUTH_WAPI_PSK
            bool "WAPI PSK"
    endchoice

    choice EXAMPLE_ADC2_CHANNEL
        bool "ADC2 Channel Num"
        depends on IDF_TARGET_ESP32
        default EXAMPLE_ADC2_CHANNEL_7
        help
            The channel of ADC2 used in this example.

        config EXAMPLE_ADC2_CHANNEL_0
            bool "ADC2 Channel 0 (GPIO 4)"
        config EXAMPLE_ADC2_CHANNEL_1
            bool "ADC2 Channel 1 (GPIO 0)"
        config EXAMPLE_ADC2_CHANNEL_2
            bool "ADC2 Channel 2 (GPIO 2)"
        config EXAMPLE_ADC2_CHANNEL_3
            bool "ADC2 Channel 3 (GPIO 15)"
        config EXAMPLE_ADC2_CHANNEL_4
            bool "ADC2 Channel 4 (GPIO 13)"
        config EXAMPLE_ADC2_CHANNEL_5
            bool "ADC2 Channel 5 (GPIO 12)"
        config EXAMPLE_ADC2_CHANNEL_6
            bool "ADC2 Channel 6 (GPIO 14)"
        config EXAMPLE_ADC2_CHANNEL_7
            bool "ADC2 Channel 7 (GPIO 27)"
        config EXAMPLE_ADC2_CHANNEL_8
            bool "ADC2 Channel 8 (GPIO 25)"
        config EXAMPLE_ADC2_CHANNEL_9
            bool "ADC2 Channel 9 (GPIO 26)"
    endchoice

    choice EXAMPLE_ADC2_CHANNEL
        bool "ADC2 Channel Num"
        depends on IDF_TARGET_ESP32S2
        default EXAMPLE_ADC2_CHANNEL_7
        help
            The channel of ADC2 used in this example.

        config EXAMPLE_ADC2_CHANNEL_0
            bool "ADC2 Channel 0 (GPIO 11)"
        config EXAMPLE_ADC2_CHANNEL_1
            bool "ADC2 Channel 1 (GPIO 12)"
        config EXAMPLE_ADC2_CHANNEL_2
            bool "ADC2 Channel 2 (GPIO 13)"
        config EXAMPLE_ADC2_CHANNEL_3
            bool "ADC2 Channel 3 (GPIO 14)"
        config EXAMPLE_ADC2_CHANNEL_4
            bool "ADC2 Channel 4 (GPIO 15)"
        config EXAMPLE_ADC2_CHANNEL_5
            bool "ADC2 Channel 5 (GPIO 16)"
        config EXAMPLE_ADC2_CHANNEL_6
            bool "ADC2 Channel 6 (GPIO 17)"
        config EXAMPLE_ADC2_CHANNEL_7
            bool "ADC2 Channel 7 (GPIO 18)"
        config EXAMPLE_ADC2_CHANNEL_8
            bool "ADC2 Channel 8 (GPIO 19)"
        config EXAMPLE_ADC2_CHANNEL_9
            bool "ADC2 Channel 9 (GPIO 20)"
    endchoice

    config EXAMPLE_ADC2_CHANNEL
        int
        default 0 if EXAMPLE_ADC2_CHANNEL_0
        default 1 if EXAMPLE_ADC2_CHANNEL_1
        default 2 if EXAMPLE_ADC2_CHANNEL_2
        default 3 if EXAMPLE_ADC2_CHANNEL_3
        default 4 if EXAMPLE_ADC2_CHANNEL_4
        default 5 if EXAMPLE_ADC2_CHANNEL_5
        default 6 if EXAMPLE_ADC2_CHANNEL_6
        default 7 if EXAMPLE_ADC2_CHANNEL_7
        default 8 if EXAMPLE_ADC2_CHANNEL_8
        default 9 if EXAMPLE_ADC2_CHANNEL_9

    choice EXAMPLE_DAC_CHANNEL
        bool "DAC Channel Num"
        depends on IDF_TARGET_ESP32
        default EXAMPLE_DAC_CHANNEL_1
        help
            The channel of DAC used in this example.

        config EXAMPLE_DAC_CHANNEL_1
            bool "DAC Channel 1 (GPIO25)"
        config EXAMPLE_DAC_CHANNEL_2
            bool "DAC Channel 2 (GPIO26)"
    endchoice

    choice EXAMPLE_DAC_CHANNEL
        bool "DAC Channel Num"
        depends on IDF_TARGET_ESP32S2
        default EXAMPLE_DAC_CHANNEL_1
        help
            The channel of DAC used in this example.

        config EXAMPLE_DAC_CHANNEL_1
            bool "DAC Channel 1 (GPIO17)"
        config EXAMPLE_DAC_CHANNEL_2
            bool "DAC Channel 2 (GPIO18)"
    endchoice

    config EXAMPLE_DAC_CHANNEL
        int
        default 0 if EXAMPLE_DAC_CHANNEL_1
        default 1 if EXAMPLE_DAC_CHANNEL_2


endmenu
```
